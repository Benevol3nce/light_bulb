## Kconfig.sysbuild
```kconfig
#
# Copyright (c) 2023 Nordic Semiconductor ASA
#
# SPDX-License-Identifier: LicenseRef-Nordic-5-Clause
#

#### Radio core selection
config NRF_DEFAULT_IPC_RADIO
    bool "Enable IPC Radio"
    default y

# Enable IEEE802.15.4 serialization to network core
config NETCORE_IPC_RADIO_IEEE802154
    bool "Enable IEEE802.15.4 Serialization"
    default y if SOC_SERIES_NRF53X && !WIFI_NRF700X

# Enable Bluetooth serialization to network core
config NETCORE_IPC_RADIO_BT_HCI_IPC
    bool "Enable Bluetooth Serialization"
    default y if SOC_SERIES_NRF53X

#### Bootloader
choice BOOTLOADER
    prompt "Select Bootloader"
    default BOOTLOADER_MCUBOOT if !BOARD_NRF21540DK
endchoice

if BOOTLOADER_MCUBOOT

#### DFU multi-image support
config DFU_MULTI_IMAGE_PACKAGE_BUILD
    bool "Enable DFU Multi-Image Build"
    default y

config DFU_MULTI_IMAGE_PACKAGE_APP
    bool "Enable DFU Multi-Image App"
    default y

config PM_EXTERNAL_FLASH_MCUBOOT_SECONDARY
    bool "Enable MCUBOOT Secondary on External Flash"
    default y

#### DFU network core configuration
if SOC_SERIES_NRF53X

config MCUBOOT_UPDATEABLE_IMAGES
    int "MCUBOOT Updateable Images"
    default 2

choice MCUBOOT_MODE
    prompt "MCUBOOT Mode"
    default MCUBOOT_MODE_OVERWRITE_ONLY
endchoice

choice BOOT_SIGNATURE_TYPE
    prompt "Boot Signature Type"
    default BOOT_SIGNATURE_TYPE_RSA
endchoice

config SECURE_BOOT_NETCORE
    bool "Enable Secure Boot for Netcore"
    default y

config NETCORE_APP_UPDATE
    bool "Enable Netcore App Update"
    default y

config DFU_MULTI_IMAGE_PACKAGE_NET
    bool "Enable DFU Multi-Image for Netcore"
    default y

endif # SOC_SERIES_NRF53X
endif # BOOTLOADER_MCUBOOT

#### Enable generating factory data
config MATTER_FACTORY_DATA_GENERATE
    bool "Enable Factory Data Generation for Matter"
    default y if !BOARD_NRF21540DK

source "${ZEPHYR_BASE}/share/sysbuild/Kconfig"
```
